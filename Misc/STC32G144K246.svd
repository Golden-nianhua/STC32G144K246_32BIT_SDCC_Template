# STC32G144K246 register map
Vendor: STC; File version: 2.0
STC32G144K246 芯片级外设视图：主要配置、状态与计数器。
Registers are 8-bit, read-write, no defined reset value unless marked. A register's access mark holds for its fields unless they carry their own. Offsets are from the block's base; lines under a group give offsets from that group; [hi:lo] are bit positions; {n}, {i} and the like mark numbered series; 'fields as' and 'values as' point back to an identical list; <NAME> marks a mode.

## Memory map
0x007EF3A0 CAN2 blocks up to offset 0x14 — CAN-FD2 总线活动、接收队列、错误状态和计数
0x007EF4A0 CAN1 blocks up to offset 0x14 — CAN-FD1 总线活动、接收队列、错误状态和计数
0x007EF520 DMA blocks up to offset 0xF810BCE — DMA 公共中断与各通道配置、状态
0x007EF600 PGA1 size 0x2 — 可编程增益放大器 / 运放 1
0x007EF604 PGA2 size 0x2 — 可编程增益放大器 / 运放 2
0x007EF608 PGA3 size 0x2 — 可编程增益放大器 / 运放 3
0x007EF60C PGA4 size 0x2 — 可编程增益放大器 / 运放 4
0x007EF610 DAC1 blocks up to offset 0x6 — DAC1 控制、分频和状态
0x007EF628 DAC2 blocks up to offset 0x6 — DAC2 控制、分频和状态
0x007EF688 HSPWME size 0x1 — 高速 PWM E 配置；不访问间接窗口
0x007EF68C HSPWMF size 0x1 — 高速 PWM F 配置；不访问间接窗口
0x007EF6A0 PWME blocks up to offset 0x3E — 高级 PWM E：使能、状态、计数、周期和输出
0x007EF6B5 PWMF blocks up to offset 0x49 — 高级 PWM F：使能、状态、计数、周期和输出
0x007EF700 GPIO8 blocks up to offset 0x619 — P8 端口、模式、上下拉和中断
0x007EF701 GPIO9 blocks up to offset 0x619 — P9 端口、模式、上下拉和中断
0x007EF702 GPIOA blocks up to offset 0x619 — PA 端口、模式、上下拉和中断
0x007EF703 GPIOB blocks up to offset 0x619 — PB 端口、模式、上下拉和中断
0x007EF740 UART5 blocks up to offset 0x2E — USART5 收发、运行模式与超时
0x007EF770 UART6 blocks up to offset 0x2E — USART6 收发、运行模式与超时
0x007EF7A0 UART7 blocks up to offset 0x2E — USART7 收发、运行模式与超时
0x007EF7D0 UART8 blocks up to offset 0x2E — USART8 收发、运行模式与超时
0x007EF800 SPI2 blocks up to offset 0x9 — SPI2 接口
0x007EF820 SPI3 blocks up to offset 0x9 — SPI3 接口
0x007EF860 I2C2 blocks up to offset 0xE — I2C2 主从配置、应答和中断状态
0x007EF8B1 PWMC blocks up to offset 0xB4 — 高级 PWM C：使能、状态、计数、周期和输出
0x007EF8B5 PWMD blocks up to offset 0x49 — 高级 PWM D：使能、状态、计数、周期和输出
0x007EF900 QSPI blocks up to offset 0x8 — QSPI 配置和 FIFO 水位；SR1 在自动轮询时有读副作用
0x007EF940 PWMA blocks up to offset 0x59E — 高级 PWM A：使能、状态、计数、周期和输出
0x007EF970 HSPWMC size 0x1 — 高速 PWM C 配置；不访问间接窗口
0x007EF974 HSPWMD size 0x1 — 高速 PWM D 配置；不访问间接窗口
0x007EFB30 CRC blocks up to offset 0x6 — 硬件 CRC16/32 控制及结果
0x007EFB38 ADC2 size 0x8 — ADC2 通道、触发、时序和转换结果
0x007EFB70 Comparator1 size 0x4 — 比较器 1 配置与输出状态
0x007EFB74 Comparator2 size 0x4 — 比较器 2 配置与输出状态
0x007EFB78 Comparator3 size 0x4 — 比较器 3 配置与输出状态
0x007EFB7C Comparator4 size 0x4 — 比较器 4 配置与输出状态
0x007EFBB0 Timer5_6 size 0x8 — Timer5/6：共用控制、独立计数和预分频
0x007EFBB8 Timer7_8 size 0x8 — Timer7/8：共用控制、独立计数和预分频
0x007EFBC0 Timer9_10 size 0x8 — Timer9/10：共用控制、独立计数和预分频
0x007EFBC8 Timer17_18 size 0x8 — Timer17/18：共用控制、独立计数和预分频
0x007EFBF0 HSPWMA size 0x1 — 高速 PWM A 配置；不访问间接窗口
0x007EFBF4 HSPWMB size 0x1 — 高速 PWM B 配置；不访问间接窗口
0x007EFD00 GPIO0 blocks up to offset 0xF810395 — P0 端口、模式、上下拉和中断
0x007EFD01 GPIO1 blocks up to offset 0xF810392 — P1 端口、模式、上下拉和中断
0x007EFD02 GPIO2 blocks up to offset 0xF81039F — P2 端口、模式、上下拉和中断
0x007EFD03 GPIO3 blocks up to offset 0xF8103B0 — P3 端口、模式、上下拉和中断
0x007EFD04 GPIO4 blocks up to offset 0xF8103BD — P4 端口、模式、上下拉和中断
0x007EFD05 GPIO5 blocks up to offset 0xF8103C6 — P5 端口、模式、上下拉和中断
0x007EFD06 GPIO6 blocks up to offset 0xF8103E3 — P6 端口、模式、上下拉和中断
0x007EFD07 GPIO7 blocks up to offset 0xF8103F2 — P7 端口、模式、上下拉和中断
0x007EFD60 GPIOInterrupts size 0x4 — GPIO 中断组优先级
0x007EFD69 PinMux blocks up to offset 0xF810357 — 各外设引脚选择
0x007EFD71 UART1 blocks up to offset 0xF810328 — USART1 收发、运行模式与超时
0x007EFD75 UART2 blocks up to offset 0xF810326 — USART2 收发、运行模式与超时
0x007EFD79 UART3 blocks up to offset 0xF810334 — USART3 收发、运行模式与超时
0x007EFD7D UART4 blocks up to offset 0xF810381 — USART4 收发、运行模式与超时
0x007EFD85 I2C1 blocks up to offset 0x105 — I2C1 主从配置、应答和中断状态
0x007EFD90 I2S2 blocks up to offset 0x106 — I2S2 音频接口
0x007EFD98 I2S1 blocks up to offset 0xFD — I2S1 音频接口
0x007EFDA8 ClockCalibration size 0x5 — 内部 IRC 校准与追频
0x007EFE00 Clock blocks up to offset 0xF81029E — 时钟源、分频、振荡器和 PLL
0x007EFE50 TFT blocks up to offset 0x7 — TFT 8080/6800 总线接口控制和状态
0x007EFE60 RTC blocks up to offset 0x17 — 实时时钟和中断
0x007EFE78 Timer11 size 0x4 — Timer11：控制、计数和预分频
0x007EFE90 SPI1 blocks up to offset 0xF81023F — SPI1 接口
0x007EFE93 TFPU size 0x1 — 浮点三角运算单元时钟；运算状态由专用指令访问
0x007EFE99 PowerReset blocks up to offset 0xF810267 — 电源管理、低压和复位来源
0x007EFEA0 Timer0_1 blocks up to offset 0xF8101EF — Timer0/1：共用控制、独立计数和预分频
0x007EFEA2 Timer2_4 blocks up to offset 0xF81023C — Timer2/3/4：控制、计数和预分频
0x007EFEA8 ADC1 blocks up to offset 0xF810237 — ADC1 通道、触发、时序和转换结果
0x007EFEAE Comparator blocks up to offset 0xF81023A — 比较器公共配置
0x007EFEB5 PWMB blocks up to offset 0x49 — 高级 PWM B：使能、状态、计数、周期和输出
0x10000086 DSP32 size 0x1 — DSP32 运算状态；不写入运算指令口
0x1000008F Interrupts blocks up to offset 0x65 — 核心和扩展中断控制
0x100000A1 MemoryBus blocks up to offset 0x4A — Flash 等待周期、片内 RAM 总线与缓存相关控制
0x100000AA WakeTimer size 0x2 — 掉电唤醒定时器
0x100000C1 Watchdog size 0x1 — 看门狗
0x100000C3 IAP blocks up to offset 0x34 — IAP / EEPROM 控制与时序；不暴露触发和缓冲区
0x100000DC USB blocks up to offset 0x19 — USB 2.0 FS 直接控制和时钟；端点寄存器为间接索引
0x100000F1 CAN_Interrupts size 0x1 — CAN-FD 公共中断控制
0x100000F9 LIN size 0x1 — LIN 共用控制和中断；不访问索引与数据口
